## esp32-device/components/provisioning/Kconfig
```kconfig
menu "Provisioning Configuration" 

config API_HOST
    string "API hostname - e.g. api.myserver.com or an ip address if testing locally e.g. 192.168.1.23"
    default "192.168.68.108"
    help
    The hostname the web API is located.

config API_PROTOCOL
    boolean "Use https"
    default true
    help
    Enforce HTTPS use vs HTTP.


config API_PORT
    int "API port - The port the api is reachable on."
    default 8080
    help The port the web API accepts requests.

config DEVICE_REGISTER_PATH
    string "Device register path"
    default "/device-api/register"
    help The api path to register the ESP32 device.

config SKIP_PROVISIONING
    bool "Skip provisioning (BLE + serial wait) for testing"
    default n
    help
        When enabled, the device skips BLE initialisation, the serial
        provisioning console, and the 5-second wait on every boot.
        Use this to test sensing/inference without provisioning the device.

config TRAINING_MODE
    bool "Training mode: save blob crops to SD card"
    default n
    help
        When enabled, each detected blob is extracted from the raw frame and
        saved as a JPEG to /sdcard/blobs/<boot>/ on the SD card.
        Use this to collect ESP32-camera images for CNN retraining.
        Requires an SD card to be present.

endmenu
```
